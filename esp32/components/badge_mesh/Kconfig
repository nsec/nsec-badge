## esp32/components/badge_mesh/Kconfig
```kconfig
menu "Badge Mesh"

    config BADGE_MESH_ADMIN_COMMANDS
        bool "Enable serial console admin commands over the badge mesh"
        default n
        help
            Only enable this option for admin devices. Gives extra level of control and debug options over mesh network.

endmenu
```

## esp32/components/graphics/Kconfig.projbuild
```kconfig
menu "Graphics component"

	config GRAPHICS_EYE_LED_GPIO
		int "GPIO of the eye LED"
		default 2
		help
			The GPIO pin number for the "eye" LED on the badge.

	config GRAPHICS_FAST_TILES
		bool "Enable fast tiles cache"
		default false
		help
			Allocate a buffer in the heap for all "fast" tiles in the images
			library.  This significantly speeds up rendering but uses a large
			chunk of the memory.

endmenu
```

## esp32/main/Kconfig.projbuild
```kconfig
menu "NORTHSEC 2024"
    choice

        prompt "Build selection"

        config NSEC_BUILD_CONFERENCE_FIRMWARE
            bool "Conference Firmware"
            help
                Set this when building the conference firmware.

        config NSEC_BUILD_CTF_FIRMWARE
            bool "NorthSec CTF Firmware"
            help
                Set this when building firmware distributed at the admin table during CTF.

        config NSEC_BUILD_CTF_ADDON
            bool "NorthSec CTF Addon"
            help
                Set this when building firmware for the CTF Addcon that is available during CTF.

    endchoice
endmenu
```

## esp32/sdkconfig.defaults
```kconfig
CONFIG_IDF_TARGET="esp32s3"
CONFIG_ESPTOOLPY_FLASHSIZE_8MB=y
CONFIG_ESPTOOLPY_HEADER_FLASHSIZE_UPDATE=y
CONFIG_PARTITION_TABLE_TWO_OTA=y
CONFIG_ESP_PHY_REDUCE_TX_POWER=y
CONFIG_LWIP_NETIF_API=y
CONFIG_LWIP_IRAM_OPTIMIZATION=y
CONFIG_LWIP_AUTOIP=y
CONFIG_SOC_UART_SUPPORT_RTC_CLK=y
```

## main/Kconfig.projbuild
```kconfig
# SPDX-FileCopyrightText: 2024 NorthSec
#
# SPDX-License-Identifier: MIT

menu "NORTHSEC 2024"
    choice

        prompt "Firmware build selection"

        config NSEC_BUILD_CONFERENCE
            bool "NorthSec Conference"
            help
                Set this when building the conference firmware.

        config NSEC_BUILD_CTF
            bool "NorthSec CTF"
            help
                Set this when building firmware distributed at the admin table during CTF.

        config NSEC_BUILD_ADDON
            bool "NorthSec CTF Addon"
            help
                Set this when building firmware for the CTF Addcon that is available during CTF.

    endchoice
endmenu
```
